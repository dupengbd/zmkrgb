## boards/shields/zmkdp/Kconfig.defconfig
```kconfig
if SHIELD_ZMKDP_LEFT

# Name must be less than 16 characters long!
config ZMK_KEYBOARD_NAME
    default "zmkdp"

config ZMK_SPLIT_ROLE_CENTRAL
    default y

config ZMK_SPLIT_BLE_CENTRAL_PERIPHERALS
  default 2

config BT_MAX_CONN
    default 7

config BT_MAX_PAIRED
    default 7

# Bump this value needed for concurrent GATT discovery of splits
config BT_L2CAP_TX_BUF_COUNT
    default 15 if ZMK_SPLIT_ROLE_CENTRAL

endif

if SHIELD_ZMKDP_LEFT || SHIELD_ZMKDP_RIGHT || SHIELD_ZMKDP_THIRD

config ZMK_SPLIT
    default y

endif

# --- Pinctrl Kconfig for part "left" ---
if BOARD_NICE_NANO_V2 && SHIELD_ZMKDP_LEFT

config I2C
    default y

config ZMK_DISPLAY
    default y

if ZMK_DISPLAY

# 使用 codekeeb/zmk-nice-oled fork 的自定义状态屏幕
config ZMK_DISPLAY_STATUS_SCREEN_CUSTOM
    default y

config I2C
    default y

config SSD1306
    default y

endif # ZMK_DISPLAY

if LVGL

config LV_Z_VDB_SIZE
    default 64

config LV_DPI_DEF
    default 148

config LV_Z_BITS_PER_PIXEL
    default 1

choice LV_COLOR_DEPTH
    default LV_COLOR_DEPTH_1
endchoice

endif # LVGL

config SPI
    default y

config WS2812_STRIP
    default y

endif

# --- Pinctrl Kconfig for part "right" ---
if BOARD_NICE_NANO_V2 && SHIELD_ZMKDP_RIGHT

config I2C
    default y

config ZMK_DISPLAY
    default y

if ZMK_DISPLAY

config ZMK_DISPLAY_STATUS_SCREEN_CUSTOM
    default y

config I2C
    default y

config SSD1306
    default y

endif # ZMK_DISPLAY

if LVGL

config LV_Z_VDB_SIZE
    default 64

config LV_DPI_DEF
    default 148

config LV_Z_BITS_PER_PIXEL
    default 1

choice LV_COLOR_DEPTH
    default LV_COLOR_DEPTH_1
endchoice

endif # LVGL

config SPI
    default y

config WS2812_STRIP
    default y

endif
```

## boards/shields/zmkdp/Kconfig.shield
```kconfig
config SHIELD_ZMKDP_LEFT
    def_bool $(shields_list_contains,zmkdp_left)

config SHIELD_ZMKDP_RIGHT
    def_bool $(shields_list_contains,zmkdp_right)

config SHIELD_ZMKDP_THIRD
    def_bool $(shields_list_contains,zmkdp_third)
```
